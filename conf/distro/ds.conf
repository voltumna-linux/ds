## conf/distro/ds.conf
```bitbake
require conf/distro/voltumna.conf

DISTRO_NAME = "DS"
SDK_VENDOR = "-dssdk"
TARGET_VENDOR = "-ds"

# Necessary to add lapack
FORTRAN:forcevariable = ",fortran"
RUNTIMETARGET:append:pn-gcc-runtime = " libquadmath"
```

## conf/machine/naples-kvm.conf
```bitbake
#@TYPE: Machine
#@NAME: KVM virtual machine
#@DESCRIPTION: Machine configuration for the http://linux-kvm.org virtual machine 

require include/naples.inc

MACHINEOVERRIDES =. "kvm:"

IMAGE_FSTYPES = "tar"

PRIMARY_NETIF = "enp0s18"
ROOT = "/dev/vda2"

EXTRA_IMAGEDEPENDS += "grub-efi grub-bootconf"
PREFERRED_PROVIDER_virtual/bootloader = "grub-efi"

MACHINE_EXTRA_RRECOMMENDS:remove = "kernel-modules linux-firmware"
MACHINE_EXTRA_RRECOMMENDS:append = " qemu-guest-agent"

COMPATIBLE_MACHINE:pn-dpdk = "${MACHINE}"
COMPATIBLE_MACHINE:pn-nativesdk-dpdk = "(.*)"

MACHINE_ESSENTIAL_EXTRA_RDEPENDS:remove = "thermald"
```
